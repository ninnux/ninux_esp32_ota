## Kconfig
```kconfig
menu "Ninux OTA Configuration"

    config WIFI_SSID
        string "WiFi SSID"
        default "myssid"
        help
            SSID (network name) for the example to connect to.

    config WIFI_PASSWORD
        string "WiFi Password"
        default "mypassword"
        help
            WiFi password (WPA or WPA2) for the example to use.

    config FIRMWARE_UPGRADE_HOST
        string "firmware upgrade url endpoint"
        default "https://iotfw.ninux.org"
        help
            URL of server which hosts the firmware
            image.
endmenu
```
